## conf/machine/seeed-reterminal-mender.conf
```bitbake
require conf/machine/seeed-reterminal.conf
# mender conf
# mender needs a single dtb but meta-raspberrypi includes all models
#KERNEL_DEVICETREE = "broadcom/bcm2711-rpi-cm4.dtb"
MENDER_ARTIFACT_NAME = "reterminal-release-1"
INHERIT += "mender-full"
RPI_USE_U_BOOT = "1"
MENDER_BOOT_PART_SIZE_MB = "64"
IMAGE_INSTALL:append = " kernel-image kernel-devicetree"
IMAGE_FSTYPES:remove = " rpi-sdimg"
MENDER_FEATURES_ENABLE:append = " mender-uboot mender-image-sd"
MENDER_FEATURES_DISABLE:append = " mender-grub mender-image-uefi"
MENDER_STORAGE_TOTAL_SIZE_MB = "4096"
PREFERRED_VERSION_mender = "5.0.3"
```
